## zephcore/boards/nrf52840/thinknode_m6/Kconfig.thinknode_m6
```kconfig
# Copyright (c) 2025 ZephCore
#
# SPDX-License-Identifier: Apache-2.0

config BOARD_THINKNODE_M6
	select SOC_NRF52840_QIAA
```

## zephcore/boards/nrf52840/thinknode_m6/board.yml
```yaml
# Copyright (c) 2025 ZephCore
#
# SPDX-License-Identifier: Apache-2.0

board:
  name: thinknode_m6
  full_name: Elecrow ThinkNode M6 (nRF52840 + SX1262)
  vendor: elecrow
  socs:
  - name: nrf52840
```

## zephcore/west.yml
```yaml
manifest:
  remotes:
    - name: zephyrproject-rtos
      url-base: https://github.com/zephyrproject-rtos

  projects:
    - name: zephyr
      remote: zephyrproject-rtos
      revision: e7c454caf8192d9063b7ce1ec8497a04d11e97de
      import: true

  self:
    path: zephcore
```
